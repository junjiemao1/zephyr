## boards/x86/acrn/Kconfig.defconfig
```kconfig
#
# Copyright (c) 2019 Intel Corporation
#
# SPDX-License-Identifier: Apache-2.0
#

if BOARD_ACRN

config BOARD
	default "acrn"

config JAILHOUSE_X2APIC
	bool "access APIC in x2APIC mode"

endif # BOARD_ACRN
```

## drivers/ethernet/Kconfig.e1000e
```kconfig
# Kconfig - Intel(R) PRO/1000 Gigabit Ethernet driver configuration options

#
# Copyright (c) 2018 Intel Corporation
#
# SPDX-License-Identifier: Apache-2.0
#

menuconfig ETH_E1000E
	bool "Intel(R) 82574 Gigabit Ethernet Controller Family driver"
	depends on PCIE
	depends on PCIE_MSI
	help
	  Enable Intel(R) 82574 Gigabit Ethernet Controller Family driver.

# Hidden option
config ETH_NIC_MODEL
	string
	default "e1000e"
	depends on ETH_E1000E
	help
	  Tells what Qemu network model to use. This value is given as
	  a parameter to -nic qemu command line option.
```
